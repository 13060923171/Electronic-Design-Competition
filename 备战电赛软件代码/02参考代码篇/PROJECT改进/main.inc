
	.DEF _vula_adc=R5
_3:
	.DW  _0*2+0x00
	.DW  _0*2+0x06
	.DW  _0*2+0x0C
	.DW  _0*2+0x12
	.DW  _0*2+0x18
_4:
	.DW  _0*2+0x1E
	.DW  _0*2+0x25
	.DW  _0*2+0x2C
_5:
	.DW  _0*2+0x33
	.DW  _0*2+0x39
	.DW  _0*2+0x40
	.DW  _0*2+0x47
	.DW  _0*2+0x4E
	.DEF _buzz_S0=R4
_0:
	.DB  0x73,0x74,0x65,0x70,0x41,0x0,0x73,0x74
	.DB  0x65,0x70,0x42,0x0,0x73,0x74,0x65,0x70
	.DB  0x43,0x0,0x62,0x61,0x63,0x6B,0x20,0x0
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	.DB  0x20,0x20,0x20,0x20,0x0

__GLOBAL_INI_TBL:
	.DW  0x0A
	.DW  _step
	.DW  _3*2

	.DW  0x06
	.DW  _mode
	.DW  _4*2

	.DW  0x0A
	.DW  _display
	.DW  _5*2

	.DW  0
_0xE6:
