/*--------------------------------------------------------------*/
#include <AT89X52.H>
#include "Font_code.c"
#include "LCD128X64_V3.C"


unsigned char code *string = {"I love you hui."};

unsigned char code pic[] = {	//128*64
0x00,0x00,0x00,0x00,0x00,0x00,0x00,0x00,0x00,0x00,0x00,0x00,0x00,0x00,0x00,0xE0,
0xF8,0xDA,0xED,0xF6,0x7B,0xBD,0xCE,0xF7,0x3F,0xDF,0xEF,0xFD,0xF2,0xEF,0xB8,0xFF,
0x7F,0xAF,0xFF,0x77,0xFD,0x96,0x69,0x54,0x2A,0xFF,0xFA,0xF7,0xEE,0xBD,0xFE,0xB7,
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0x0D,0x02,0x0C,0x21,0x1E,0xE0,0x00,0x00,0x00,0x00,0x04,0x72,0xDC,0x72,0xFC,0x46};

unsigned char code str[][32] = {	//16*16
0x00,0x00,0xFC,0x44,0x54,0x54,0x54,0x55,0xFE,0x54,0x54,0x54,0xF4,0x44,0x44,0x00,
0x80,0x60,0x1F,0x20,0x63,0x15,0x49,0x81,0x7F,0x0D,0x11,0x29,0x6D,0xC0,0x40,0x00,//康0
0x88,0x68,0xFF,0x28,0x48,0x18,0x92,0x52,0x32,0x1E,0x32,0x52,0x92,0x12,0x10,0x00,
0x01,0x00,0xFF,0x00,0x01,0x41,0x30,0x0F,0x00,0x00,0x00,0xFF,0x00,0x01,0x01,0x00};//桥1

unsigned char code pic1[] = {	//39*40
0x00,0x00,0x00,0x00,0x00,0xC0,0xF0,0xF8,0xFE,0xFE,0x7F,0xFF,0xFF,0xBF,0x7F,0xFF,
0xFF,0xFF,0x7F,0xFF,0xFF,0xEF,0xEF,0xDF,0xD7,0xC3,0x07,0x07,0x01,0x03,0x87,0x2F,
0xCF,0xBE,0xFC,0xF8,0xE0,0x00,0x00,0x40,0x60,0x30,0xF8,0xFE,0xFF,0xFF,0x7F,0x0F,
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0xFF,0xFF,0xFF};


/*--------------------------------------------------------------*/
//延时500000+0us 函数定义
void delay500ms(void)
{
    unsigned char i,j,k;
    for(i=205;i>0;i--)
    for(j=116;j>0;j--)
    for(k=9;k>0;k--);
}
//延时200000+0us 函数定义
void delay200ms(void)
{
    unsigned char i,j,k;
    for(i=201;i>0;i--)
    for(j=32;j>0;j--)
    for(k=14;k>0;k--);
}


/*--------------------------------------------------------------*/
//主函数
void main(void)
{
	unsigned char i, j;

	LCD_init_12864();

	while(*string)	{LCD_printc(0, i, *string++); i++; delay200ms();}	//字符输出演示
	delay500ms();
	LCD_prints(1, 0, "Haha,I love you.");			//字符串输出演示
	delay500ms();
	LCD_prints(2, 0, "I am glad to see");
	delay500ms();
	LCD_prints(3, 0, "you again(*^_^*)");
#if (Font_type == 0)	//(8*16字体)
	LCD_printc(4, 0, 131);
	LCD_printc(4, 1, 127);
	delay500ms();
	LCD_prints(4, 2, "love you from ");
	delay500ms();
	LCD_prints(5, 0, "the bottom of my");
	delay500ms();
	LCD_prints(6, 0, "heart,hui. Yes,I");
	LCD_printc(6, 5, 132);
	LCD_prints(7, 0, "'ll devote to it");
	delay500ms();
#endif

	LCD_printch(0, 0, str[0]); LCD_printch(0, 1, str[1]);
	delay500ms();delay500ms();
	LCD_inversesh(0, 0, 2);
	delay500ms();delay500ms();
	LCD_pos_picture(0, 32, 39, 40, pic1);
	delay500ms();delay500ms();

	LCD_picture(pic);
	delay500ms();delay500ms();
	delay500ms();delay500ms();
	LCD_scr_inverse();	//屏幕反色显示
	delay500ms();

	LCD_clr_scr(ASCR);	//清屏
	//画点
	for(i = 0; i < 64; i++) {LCD_pixel(i, i, 1); delay200ms();}
	for(i = 0; i < 64; i++) LCD_pixel(i+64, 63-i, 1);


	delay500ms();
	LCD_clr_scr(ASCR);	//清屏
#if (Font_type == 0)	//(8*8字体)		
	for(i = 8; i <= 128; i+=8) LCD_line_v(i-1, 1);	//列线		
#endif	


#if (Font_type == 0)	//(8*8字体)
	i = 0;
	while(i < 101)		//ASCII字符测试
	{ 
		LCD_printc(j & 0x07, i & 0x0f, i + 32); 
		delay200ms(); i++;
		if(!(i % 16)) j++;
	}
#else					//(8*16字体)
	i = 0;
	while(i < 95)		//ASCII字符测试
	{ 
		LCD_printc(j & 0x03, i & 0x0f, i + 32); 
		delay200ms(); i++;
		if(!(i % 16)) j++;
	}
#endif


#if (Font_type == 0)	//(8*8字体)	
	LCD_prints(7, 0, "www.Alex2008.com");
#else					//(8*16字体)
	LCD_prints(3, 0, "www.Alex2008.com");
#endif


#if (Font_type == 0)	//(8*8字体)
	for(j = 8; j <= 64; j+=8) LCD_line_h(j-1, 1);	//行线
#else					//(8*16字体)
	for(j = 16; j <= 64; j+=16) LCD_line_h(j-1, 1);	//行线
	for(i = 8; i < 128; i+=8) LCD_line_v(i, 1);		//列线
#endif
	

#if (Font_type == 0)	//(8*8字体)	
	for(i = 0; i < 8; i++)	{LCD_inverses(i, 0, 16); delay500ms(); LCD_inverses(i, 0, 16);}
#else					//(8*16字体)
	for(i = 0; i < 4; i++)	{LCD_inverses(i, 0, 16); delay500ms(); LCD_inverses(i, 0, 16);}
#endif

//	delay500ms();
#if (Font_type == 0)	//(8*8字体)
	for(j = 8; j <= 64; j+=8) 	LCD_line_h(j-1, 0);	//行线
	for(i = 8; i <= 128; i+=8) 	LCD_line_v(i-1, 0);	//列线	
#else					//(8*16字体)
	for(j = 16; j <= 64; j+=16) LCD_line_h(j-1, 0);	//行线
	for(i = 8; i < 128; i+=8) 	LCD_line_v(i, 0);	//列线
#endif	


	LCD_sel_all		//全屏
	while(1)
	{
		if(P3_5 == 0) LCD_show_on  while(P3_5 == 0);
		if(P3_4 == 0) LCD_show_off while(P3_4 == 0);
	}
}

