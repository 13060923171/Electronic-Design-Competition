//------------------------------------------------------------------------------------------------
//		Topway Test Program
//	Copyright 2003.6.6 TOPWAY Inc.
//------------------------------------------------------------------------------------------------
//The following is for LM12864a liquid crystal module drived
//by S6D0107 & S6D0108 LCD controller
#include <stdio.h>
#include <reg52.h>
#include <intrins.h>
//#include "12864f.h"
#define uchar unsigned char
#define uint unsigned int
uchar key_temp;
bit key1=1;	//当该健按下一次，自动运行和单步运行交替操作
bit key2=0;	//自动运行
bit key3=0;	//调节对比度
bit key4=0;	//处于单步运行时，每按一次按键，往下步运行一步
uchar 	temp_P1;
uchar	temp_P3;
//define flag	
static bit step_f;
uchar error_num;	//1:表示状态忙判断超时导致的错误；
        		   	//2:
        		  	//3:
        		  	//4:
//------------------------------------------------------------------------------------------------
//define variable etc.
//------------------------------------------------------------------------------------------------
uint code HZ0[]={
0x00,0x82,0x04,0x04,0xFC,0x04,0x04,0x00,0x02,0xF8,0x04,0x04,0x04,0x04,0xF8,0x00,
0x02,0xFC,0x24,0x24,0x24,0x18,0x00,0x01,0x0C,0xF0,0x00,0x01,0xF8,0x04,0xF8,0x00,
0x01,0xF0,0x0C,0x00,0x01,0xE0,0x58,0x44,0x58,0xE0,0x00,0x01,0x04,0x08,0x10,0xE0,
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0x08,0x3F,0x08,0x00,0x01,0x3F,0x20,0x20,0x20,0x20,0x00,0x89
};
//------------------------------------------------------------------------------------------------
uint code en20[]={0x00,0x00,0x00,0x00,0x00,0x00,0x00,0x00};//" "
uint code en21[]={0x00,0x06,0x5F,0x5F,0x06,0x00,0x00,0x00};//"!"
uint code en22[]={0x00,0x00,0x00,0x00,0x00,0x00,0x00,0x00};
uint code en23[]={0x00,0x00,0x00,0x00,0x00,0x00,0x00,0x00};
uint code en24[]={0x00,0x00,0x00,0x00,0x00,0x00,0x00,0x00};
uint code en25[]={0x00,0x00,0x00,0x00,0x00,0x00,0x00,0x00};
uint code en26[]={0x00,0x00,0x00,0x00,0x00,0x00,0x00,0x00};
uint code en27[]={0x00,0x00,0x00,0x00,0x00,0x00,0x00,0x00};
uint code en28[]={0x00,0x1C,0x3E,0x63,0x41,0x00,0x00,0x00};// "("
uint code en29[]={0x00,0x41,0x63,0x3E,0x1C,0x00,0x00,0x00};// ")"
uint code en2a[]={0x00,0x00,0x00,0x00,0x00,0x00,0x00,0x00};
uint code en2b[]={0x00,0x00,0x00,0x00,0x00,0x00,0x00,0x00};
uint code en2c[]={0x80,0xE0,0x60,0x00,0x00,0x00,0x00,0x00};// ","
uint code en2d[]={0x08,0x08,0x08,0x08,0x08,0x08,0x00,0x00};// "-"
uint code en2e[]={0x00,0x60,0x60,0x00,0x00,0x00,0x00,0x00};// "."
uint code en2f[]={0x00,0x00,0x00,0x00,0x00,0x00,0x00,0x00};
uint code en30[]={0x3E,0x7F,0x71,0x59,0x4D,0x7F,0x3E,0x00};// "0"
uint code en31[]={0x00,0x42,0x7F,0x7F,0x40,0x00,0x00,0x00};//1"
uint code en32[]={0x62,0x73,0x59,0x49,0x4F,0x46,0x00,0x00};//2"
uint code en33[]={0x22,0x63,0x49,0x49,0x7F,0x36,0x00,0x00};//3"
uint code en34[]={0x1C,0x1E,0x13,0x51,0x7F,0x7F,0x50,0x00};//4"
uint code en35[]={0x27,0x67,0x45,0x45,0x7D,0x39,0x00,0x00};//5"
uint code en36[]={0x3C,0x7E,0x4B,0x49,0x79,0x30,0x00,0x00};//6"
uint code en37[]={0x03,0x03,0x71,0x79,0x0F,0x07,0x00,0x00};//7"
uint code en38[]={0x36,0x7F,0x49,0x49,0x7F,0x36,0x00,0x00};//8"
uint code en39[]={0x26,0x6F,0x49,0x49,0x7F,0x3E,0x00,0x00};//9"
uint code en3a[]={0x00,0x00,0x66,0x66,0x00,0x00,0x00,0x00};//:"
uint code en3b[]={0x00,0x00,0x00,0x00,0x00,0x00,0x00,0x00};
uint code en3c[]={0x00,0x00,0x00,0x00,0x00,0x00,0x00,0x00};
uint code en3d[]={0x00,0x00,0x00,0x00,0x00,0x00,0x00,0x00};
uint code en3e[]={0x00,0x00,0x00,0x00,0x00,0x00,0x00,0x00};
uint code en3f[]={0x00,0x00,0x00,0x00,0x00,0x00,0x00,0x00};
uint code en40[]={0x00,0x00,0x00,0x00,0x00,0x00,0x00,0x00};
uint code en41[]={0x7C,0x7E,0x13,0x13,0x7E,0x7C,0x00,0x00};//A"
uint code en42[]={0x41,0x7F,0x7F,0x49,0x49,0x7F,0x36,0x00};//B"
uint code en43[]={0x1C,0x3E,0x63,0x41,0x41,0x63,0x22,0x00};//C"
uint code en44[]={0x41,0x7F,0x7F,0x41,0x63,0x3E,0x1C,0x00};//D"
uint code en45[]={0x41,0x7F,0x7F,0x49,0x49,0x63,0x63,0x00};//E"
uint code en46[]={0x41,0x7F,0x7F,0x49,0x1D,0x01,0x03,0x00};//F"
uint code en47[]={0x1C,0x3E,0x63,0x41,0x51,0x73,0x72,0x00};//G"
uint code en48[]={0x7F,0x7F,0x08,0x08,0x7F,0x7F,0x00,0x00};//H"
uint code en49[]={0x00,0x41,0x7F,0x7F,0x41,0x00,0x00,0x00};//I"
uint code en4a[]={0x61,0x41,0x41,0x7F,0x7F,0x01,0x00,0x00};//J"
uint code en4b[]={0x7F,0x7F,0x1C,0x36,0x63,0x41,0x00,0x00};//K"
uint code en4c[]={0x41,0x7F,0x7F,0x41,0x40,0x60,0x70,0x00};//L"
uint code en4d[]={0x7F,0x7F,0x06,0x1C,0x06,0x7F,0x7F,0x00};//M"
uint code en4e[]={0x7F,0x7F,0x06,0x0C,0x18,0x7F,0x7F,0x00};//N"
uint code en4f[]={0x1C,0x3E,0x63,0x41,0x63,0x3E,0x1C,0x00};//O"
uint code en50[]={0x41,0x7F,0x7F,0x09,0x09,0x0F,0x06,0x00};//P"
uint code en51[]={0x1C,0x7E,0x63,0x51,0x63,0x3E,0x5C,0x00};//Q"
uint code en52[]={0x41,0x7F,0x7F,0x09,0x19,0x7F,0x66,0x00};//R"
uint code en53[]={0x26,0x6F,0x4D,0x59,0x73,0x32,0x00,0x00};//S"
uint code en54[]={0x03,0x41,0x7F,0x7F,0x41,0x03,0x00,0x00};//T"
uint code en55[]={0x7F,0x7F,0x40,0x40,0x7F,0x7F,0x00,0x00};//U"
uint code en56[]={0x07,0x1F,0x78,0x40,0x78,0x1F,0x07,0x00};//V"
uint code en57[]={0x7F,0x7F,0x30,0x1C,0x30,0x7F,0x7F,0x00};//W"
uint code en58[]={0x41,0x63,0x3E,0x08,0x3E,0x63,0x41,0x00};//X"
uint code en59[]={0x07,0x4F,0x78,0x78,0x4F,0x07,0x00,0x00};//Y"
uint code en5a[]={0x43,0x61,0x71,0x59,0x4D,0x47,0x63,0x00};//Z"
uint code en5b[]={0x00,0x00,0x00,0x00,0x00,0x00,0x00,0x00};
uint code en5c[]={0x00,0x00,0x00,0x00,0x00,0x00,0x00,0x00};
uint code en5d[]={0x00,0x00,0x00,0x00,0x00,0x00,0x00,0x00};
uint code en5e[]={0x00,0x00,0x00,0x00,0x00,0x00,0x00,0x00};
uint code en5f[]={0x00,0x00,0x00,0x00,0x00,0x00,0x00,0x00};
uint code en60[]={0x00,0x00,0x00,0x00,0x00,0x00,0x00,0x00};
uint code en61[]={0x20,0x54,0x54,0x54,0x38,0x78,0x40,0x00};//a"
uint code en62[]={0x7F,0x7F,0x48,0x44,0x44,0x7C,0x38,0x00};//b"
uint code en63[]={0x38,0x7C,0x44,0x44,0x6C,0x28,0x00,0x00};//c"
uint code en64[]={0x30,0x78,0x48,0x49,0x3F,0x7F,0x40,0x00};//d"
uint code en65[]={0x38,0x7C,0x54,0x54,0x5C,0x18,0x00,0x00};//e"
uint code en66[]={0x48,0x7E,0x7F,0x49,0x03,0x02,0x00,0x00};//f"
uint code en67[]={0x98,0xBC,0xA4,0xA4,0xF8,0x7C,0x04,0x00};//g"
uint code en68[]={0x41,0x7F,0x7F,0x08,0x04,0x7C,0x78,0x00};//h"
uint code en69[]={0x00,0x44,0x7D,0x7D,0x40,0x00,0x00,0x00};//i"
uint code en6a[]={0x20,0x60,0x40,0x44,0x7D,0x3D,0x00,0x00};//j"
uint code en6b[]={0x41,0x7F,0x7F,0x10,0x38,0x6C,0x44,0x00};//k"
uint code en6c[]={0x00,0x41,0x7F,0x7F,0x40,0x00,0x00,0x00};//l"
uint code en6d[]={0x7C,0x7C,0x18,0x38,0x18,0x7C,0x7C,0x00};//m"
uint code en6e[]={0x7C,0x7C,0x04,0x04,0x7C,0x78,0x00,0x00};//n"
uint code en6f[]={0x38,0x7C,0x44,0x44,0x7C,0x38,0x00,0x00};//o"
uint code en70[]={0x84,0xFC,0xF8,0xA4,0x24,0x3C,0x18,0x00};//p"
uint code en71[]={0x0C,0x1E,0x1E,0x92,0xFE,0xFE,0x92,0x00};//q"
uint code en72[]={0x44,0x7C,0x78,0x4C,0x04,0x1C,0x18,0x00};//r"
uint code en73[]={0x48,0x5C,0x54,0x54,0x74,0x24,0x00,0x00};//s"
uint code en74[]={0x00,0x04,0x3E,0x7F,0x44,0x24,0x00,0x00};//t"
uint code en75[]={0x3C,0x7C,0x40,0x40,0x3C,0x7C,0x40,0x00};//"u"
uint code en76[]={0x1C,0x3C,0x60,0x60,0x3C,0x1C,0x00,0x00};//"v"
uint code en77[]={0x3C,0x7C,0x70,0x38,0x70,0x7C,0x3C,0x00};//"w"
uint code en78[]={0x44,0x6C,0x38,0x10,0x38,0x6C,0x44,0x00};//"x"
uint code en79[]={0x9C,0xBC,0xA0,0xA0,0xFC,0x7C,0x00,0x00};//"y"
uint code en7a[]={0x44,0x64,0x74,0x5C,0x4C,0x44,0x00,0x00};//"z"
uint code en7b[]={0x55,0xaa,0x55,0xaa,0x55,0xaa,0x55,0xaa};//码克线1
uint code en7c[]={0xaa,0x55,0xaa,0x55,0xaa,0x55,0xaa,0x55};//码克线2
uint code en7d[]={0xff,0x00,0xff,0x00,0xff,0x00,0xff,0x00};//竖线1
uint code en7e[]={0x00,0xff,0x00,0xff,0x00,0xff,0x00,0xff};//竖线2
uint code topway_en1[] ={0x34,0x4f,0x50,0x57,0x41,0x59};
uint code topway_en2[] ={0x34,0x45,0x43,0x48,0x0e,0,0x23,0x4f,0x0e,0x0c,0x2c,0x54,0x44,0x0e};
uint code topway_a[] ={0x21,0x21,0x21,0x21,0x21,0x21};
uint code topway_b[] ={0x22,0x22,0x22,0x22,0x22,0x22};
uint code topway_c[] ={0x23,0x23,0x23,0x23,0x23,0x23};
//------------------------------------------------------------------------------------------------
//------------------------------------------------------------------------------------------------
#define  DATABUS P1
sbit LCD_RST =P3^5;
sbit LCD_RW =P3^7;
sbit LCD_E  =P3^6;
sbit LCD_CS1=P3^4;
sbit LCD_CS2=P3^3;
sbit LCD_RS =P3^1;

uchar 	x_page=0;
uchar   y_com =0;
uchar   z_seg =0;
uint *p_data;
//------------------------------------------------------------------------------------------------
//辅助函数
//------------------------------------------------------------------------------------------------
void delay100us(void)		//delay TIMER1*1 ms for 12MHz
{
	uchar data i;
	for(i=0;i<25;i++)	{	_nop_();_nop_();	}
}
void delay1ms(void)		//delay TIMER1*1 ms for 12MHz
{
	uchar data i;
	for(i=0;i<250;i++)	{	_nop_();_nop_();	}
}
void delay100ms(void)
{
	uchar data j;
	for(j=0;j<80;j++)	{	delay1ms();	}	
}
void delay500ms(void)
{
	uchar data l;
	for(l=0;l<2;l++)	{	delay100ms();	}	
}
void delay1s(void)
{
	uchar data l;
	for(l=0;l<6;l++)	{	delay100ms();	}
}
//------------------------------------------------------------------------------------------------
//以下是驱动函数
//------------------------------------------------------------------------------------------------
void s_chip(uchar chip)	//chip=0：全选，chip=1：选择左边一片108，＝2：选择右边一片108;＝3：都不选择
{
	switch(chip)
		{
			case 0:		LCD_CS1=1;	LCD_CS2=1; break;
			case 1:		LCD_CS1=0;	LCD_CS2=1; break;
			case 2:		LCD_CS1=1;	LCD_CS2=0; break;
			case 3:		LCD_CS1=0;	LCD_CS2=0; break;
			default:	break;
		}
}
//------------------------------------
void wcode(uchar cc)    //send insruction
{
    LCD_RW=0;    LCD_RS=0;    DATABUS=cc;
    LCD_E=0;    _nop_();_nop_();LCD_E=1; delay100us();LCD_E=0;
    delay100us();	//test
}
void wdata(uchar dd)    		//send data
{
    LCD_RW=0;    LCD_RS=1;    DATABUS=dd;
    LCD_E=0;    _nop_();_nop_();
    LCD_E=1;    delay100us();LCD_E=0;
    delay100us();	//test
}
//------------------------------------
//功    能：写一个字符
//函数描述：col_add(0-127):所有列统一编址；p_data:待写数据首地址
void w_data_char(uchar col_add,uint *pp_data)
{
	uchar i=0,chip=0,data_temp=0;
	LCD_RW=0;    LCD_RS=0;
	data_temp = 0x40|col_add;	//0xc0		//写列地址
	wcode(data_temp);
	
	for(i=0;i<8;i++)
	{
		wdata(*pp_data);	pp_data++;
	}	
}
//------------------------------------
//功    能：写一个汉字
//函数描述：pager(0-7):该字起始页;col_add(0-127):所有列统一编址；p_data:待写数据首地址
void w_data_word(uchar pager,col_add,uint *p_data)
{
	uchar i=0,chip=0,pager_temp=0,data_temp=0;
	LCD_RW=0;    LCD_RS=0;
	if(pager>=7)	pager=0;
	pager_temp=0xb8|pager;				//写页
	wcode(pager_temp);
	data_temp = 0x40|col_add;	//0xc0		//写列地址
	wcode(data_temp);
	//data_temp = 0xc0|col_add;	//0xc0		//写列地址
	//wcode(data_temp);
	for(i=0;i<16;i++)
	{	wdata(*p_data);	p_data +=1;
	}
	
	pager +=1;pager_temp=0xb8|pager;	
	wcode(pager_temp);
	data_temp = 0x40|col_add;			//写列地址
	wcode(data_temp);
	//data_temp = 0xc0|col_add;	//0xc0		//写列地址
	//wcode(data_temp);
	for(i=0;i<16;i++)
	{	wdata(*p_data);	p_data +=1;
	}
}
//------------------------------------
//功    能：写一行（page）字符(16个字符)
//函数描述：page(0-7):所有芯片统一的页;col_add(0-127):待写列地址，所有列统一编址；*char_add:代谢字符串首地址；d_size:待写字符个数；<=16
void w_data_page(uchar pager,col_add,uint *char_add,uchar d_size)
{
	uchar i;
	//col_add=0;
	for(i=0;i<d_size;i++)
	{
		p_data =(&en20)+(*(char_add+i))*8;
		if(col_add>=64)
		{		
			s_chip(2);
			wcode(0xb8|pager);	w_data_char(col_add-64,p_data);
			col_add +=8;
		}
		else
		{	
			s_chip(1);
			wcode(0xb8|pager);	w_data_char(col_add,p_data);
			col_add += 8;
		}
	}
}
//------------------------------------
 void	w_data_entw()			//显示托微英文
{
	//p_data=topway_en;
	w_data_page(1,32,topway_en1,6);
	w_data_page(2,8,topway_en2,14);
}
//------------------------------图形解压算法处理------------------------------------
struct OutData
{
	uint amount;	//输出0x00或0xff的数量;
	uchar OutData;	//输出0x00或0xff;
	uchar AddNum;
};
static struct  OutData OutPutData;
//---------------------解压函数---------------------------
//功能：解压图形数据
//输入:需要取出的当前数据所在位置的指针到 *data_temp;
//输出:0x00或0xff的数量到OutPutData.amount;输出0x00或0xff到OutPutData.OutData;
//
void Decompression(uint *data_temp)	//输入需要取出的当前数据所在位置的指针
{
	//uint i,temp[4];
	OutPutData.AddNum =0;
	if(((*data_temp)==0)|((*data_temp)==0xff))
	{
		if((*(data_temp+1))==0)
		{
			OutPutData.amount=((*(data_temp+3))*0xff) + (*(data_temp+2));
			OutPutData.OutData=*data_temp;
			OutPutData.AddNum +=4;
		}
		else
		{
			OutPutData.amount=*(data_temp+1);
			OutPutData.OutData=*data_temp;
			OutPutData.AddNum +=2;
		}
	}
	else
	{
		OutPutData.amount=1;
		OutPutData.OutData=*data_temp;
		OutPutData.AddNum +=1;
	}
} 
//------------------------------图形解压算法处理------------------------------------

//------------------------------------
//功    能：写一屏图形192*64
//函数描述：
void w_data_bmp(uint *p_data)
{
	
	uchar j;
	uchar i=0,pager=0,datatemp=0,col_add=0;
	LCD_RW=0;	_nop_();_nop_();
	LCD_RS=0;	delay100us();
	
	OutPutData.amount=0;	//压缩处理
	
	for(pager=0;pager<8;pager++)
	{
		for(j=0;j<2;j++)
		{
			i=64;
			s_chip(j); delay100us();
			datatemp = 0xb8|pager;				//写页
			wcode(datatemp);_nop_();_nop_();
			datatemp = 0x40|col_add;	//0xc0		//写列地址
			wcode(datatemp);_nop_();_nop_();
			while(i>0)
			{	
				if(OutPutData.amount==0)
				{
					Decompression(p_data);
					p_data +=OutPutData.AddNum;
				}
				wdata(OutPutData.OutData);		OutPutData.amount--;
				i--;
			}
			
		}
	}
}
//------------------------------------------------------------------------------------------------
//以下是应用函数
//------------------------------------------------------------------------------------------------
//功    能：显示多屏图形
void w_data_tu(uchar i)
{
	switch(i)
		{
			case 0: w_data_bmp(HZ0); break;
			case 1: ; break;
		}
	
}
//------------------------------------
//功    能：显示--
void wr_dis_h(uchar aa,bb)
{
	uchar j,k;
	uchar col_add=0;
	s_chip(0);
	for(j=0;j<8;j++)
	{
		wcode(0xb8|j);//delay100us();
		wcode(0x40);//delay100us();
		for(k=0;k<32;k++)
		{	wdata(aa);	//delay100us();
			wdata(bb);	//delay100us();
		}
	}
}
//------------------------------------------------------------------------------------------------
//以下是演示函数
//------------------------------------------------------------------------------------------------
void wr_dis(uchar dis_data)
{
	uchar i,j,pager_temp;
	s_chip(0);
	for(i=0;i<8;i++)
	{
		pager_temp=0xb8|i;				//写页
		wcode(pager_temp);
		for(j=0;j<64;j++)
		wdata(dis_data);
	}
}
void	w_data_allscreen(uint *p_data)			//显示英文
{
	uchar k;
	uchar col_add=0;
	for(k=0;k<8;k++)
	{
		w_data_page(k,0,p_data,6);w_data_page(k,48,p_data,6);
		w_data_page(k,96,p_data,4);
	}
}
void dis_test(uchar dis_number)	//screen number:2,6,7,10,11,12,13
{
	switch(dis_number)
		{
			case 1: wr_dis(0xff);break;
			case 2: wr_dis(0x00);break;
			case 3: wr_dis(0x55);break;
			case 4: wr_dis(0xaa);break;
			case 5: wr_dis_h(0x55,0xaa);break;
			case 6: wr_dis_h(0xaa,0x55);break;
			case 7: wr_dis_h(0xff,0x00);break;
			case 8: wr_dis_h(0x00,0xff);break;
			default:	error_num=2;break;
		}
}
void display_frame()
{
	uchar i,j,k;
	dis_test(2);

	s_chip(0);
	wcode(0xb8|0);
	wcode(0x40);
	wdata(0xff);
	for(k=0;k<62;k++)	wdata(0x01);
	wdata(0xff);
	
	for(j=1;j<7;j++)
	{
		wcode(0xb8|j);
		wcode(0x40);
		wdata(0xff);
		for(i=0;i<62;i++)	wdata(0x00);
		wdata(0xff);
	}
	
	wcode(0xb8|7);
	wcode(0x40);
	wdata(0xff);
	for(k=0;k<62;k++)	wdata(0x80);
	wdata(0xff);
}
//------------------------------------------------------------------------------------------------
//以下是按键功能函数
//------------------------------------------------------------------------------------------------
void time0_scan() interrupt 1 using 2
{
	bit cs11=0,cs22=0;
	cs11=LCD_CS1;cs22=LCD_CS2;
	LCD_CS1=1;LCD_CS2=1;
	temp_P1=P1;
	temp_P3=P3;
	key_temp=0x00;
	P1=temp_P1|0x0f;P3=temp_P3&0xfe;_nop_();_nop_();_nop_();_nop_();
	key_temp=P1|0xf0;//P3^0=0;
	_nop_();_nop_();_nop_();
	
	if(key_temp==0xfe)	{key1 =0;key2=0;key3=0;key4=0;}//key1按下时为单步
	else if(key_temp==0xfd)	{key2=1;key3=0;key4=0;}
	else if(key_temp==0xfb)	{key3=1;key2=0;key4=0;}
	else if(key_temp==0xf7)	{key4=1;key2=0;key3=0;}
	TH0=0xe1;TL0=0xdf;//置定时器1初值0xffff-20000

	P3=temp_P3|1;
	P1=temp_P1;_nop_();_nop_();_nop_();
	LCD_CS1=cs11;LCD_CS2=cs22;_nop_();_nop_();_nop_();_nop_();
}
uchar light_temp=0x18;
uchar key2_t=0;
uchar key3_t=0;
void keyfun()
{EA = 1;TR0 = 1;
	if(key1)	//如果按下，即key1=1，表示处于单步状态
	{
		for(;;)
		{		
			if(key4)	{key4=0;	break;}
			if(!key1)	{break;}
				//if(key2) break;
		}
	}
	EA = 0;TR0 = 0;
	if(!key1)  delay500ms();
}
//---------------------------------------------------------------------------------
void LCD_init()
{
	uchar i,j;
	s_chip(0);
	wcode(0x3e);	//打开显示屏
	wcode(0xc0);	//置Z向首地址为0
	wcode(0xB8);	//置X地址为首页首列0
	wcode(0x40);	//置Y向首地址为0
	for(i=0;i<8;i++)	//clear lcd
	{
		wcode(0xb8|i);
		for(j=0;j<128;j++)
		wdata(0);
	}
	wcode(0x3f);	//打开显示屏	
	//wcode(0x41);
}
//------------------------------------------------------------------------------------------------
//以下是主函数
//------------------------------------------------------------------------------------------------
void main()
{
	delay1ms();
	//RST=0;    i=20;    while(i) i--; 	RST=1;
	DATABUS=0xff;		SP=0x60;	P3=0x18; LCD_RST=1;
	LCD_CS1=0;    LCD_CS2=0;    
	LCD_RW=0;    LCD_RS=0;
	EA = 0; /* disable interrupts */
	LCD_init();
	
	TR0 = 0; /* stop timer 0 */
	IE   = 0x82;
  	TMOD = 0x01;    /* TMOD */ 
	TH0=0xe1;TL0=0xdf;//置定时器1初值0xffff-20000
	_nop_();TR0 = 0; /* start timer 0 */
	EA=0;
	while(1)
	{
		//keyfun();
		dis_test(2);
		w_data_tu(0);delay500ms();
		keyfun();		//显示托微电子
		display_frame();delay500ms();
		keyfun();
		dis_test(1);delay500ms();
		keyfun();
		dis_test(2);delay500ms();
		keyfun();
		dis_test(3);delay500ms();
		keyfun();
		dis_test(4);delay500ms();
		keyfun();	
		dis_test(5);delay500ms();
		keyfun();
		dis_test(6);delay500ms();
		keyfun();	
		dis_test(7);delay500ms();
		keyfun();	
		dis_test(8);delay500ms();
		keyfun();
		w_data_allscreen(topway_en1);delay500ms();
		keyfun();
		w_data_allscreen(topway_a);delay500ms();
		keyfun();
		w_data_allscreen(topway_b);delay500ms();
		keyfun();
		w_data_allscreen(topway_c);delay500ms();
		keyfun();
	}
}
